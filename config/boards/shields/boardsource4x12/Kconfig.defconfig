## config/boards/shields/boardsource4x12/Kconfig.defconfig
```kconfig
# Copyright (c) 2021 The ZMK Contributors
# SPDX-License-Identifier: MIT

if SHIELD_BOARDSOURCE4X12

config ZMK_KEYBOARD_NAME
    default "Boardsource 4x12"

endif
```
